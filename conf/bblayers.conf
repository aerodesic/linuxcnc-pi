## conf/bblayers.conf
```bitbake
# POKY_BBLAYERS_CONF_VERSION is increased each time build/conf/bblayers.conf
# changes incompatibly
POKY_BBLAYERS_CONF_VERSION = "2"

BBPATH = "${TOPDIR}"
BBFILES ?= ""

SRCROOT = "/home/go/linuxcnc-builder-20190329"

BBLAYERS ?= " \
  ${SRCROOT}/poky/meta \
  ${SRCROOT}/poky/meta-poky \
  ${SRCROOT}/poky/meta-openembedded/meta-oe \
  ${SRCROOT}/poky/meta-openembedded/meta-multimedia \
  ${SRCROOT}/poky/meta-openembedded/meta-networking \
  ${SRCROOT}/poky/meta-openembedded/meta-perl \
  ${SRCROOT}/poky/meta-openembedded/meta-python \
  ${SRCROOT}/poky/meta-raspberrypi \
  ${SRCROOT}/poky/meta-qt5 \
  ${SRCROOT}/poky/meta-security \
  ${SRCROOT}/meta-aoextra \
  ${SRCROOT}/meta-package-signing \
  ${SRCROOT}/meta-linuxcnc \
  "

#  ${SRCROOT}/luv-yocto/meta-multimedia
```

## conf/local.conf
```bitbake
# Local configuration for meta-rpi images
# Yocto Project 2.4 Poky distribution [rocko] branch

INHERIT += "image-buildinfo"
EXTRA_DISTRO_FEATURES += "wayland x11"
MACHINE_FEATURES += "vc4graphics"

# Attempt to use systemd over initd
DISTRO_FEATURES_append = " systemd"
VIRTUAL-RUNTIME_init_manager = "systemd"

DEFAULT_TIMEZONE = "America/Los_Angeles"

hostname_pn-base-files = "linuxcnc"

ENABLE_SPI_BUS = "1"

# Remove black border
DISABLE_OVERSCAN = "1"

# Heavily recommended for Wayland/Weston.
DISPMANX_OFFLINE = "1"

# Disable console tty
# CMDLINE_CONSOLE = ""

KERNEL_DEVICETREE_append = " overlays/spi1-3cs.dtbo overlays/spi-rtc-ds3234.dtbo"

GPU_MEM = "128"

# Let IMAGE_FSTYPES take default
# IMAGE_FSTYPES = "tar.xz rpi-sdimg"

PREFERRED_PROVIDER_virtual/kernel = "linux-raspberrypi-rt"
PREFERRED_VERSION_linux-raspberrypi = "4.14.81"
PREFERRED_VERSION_wxwidgets = "3.0.3.1"
PREFERRED_VERSION_wxpython = "3.0.2.0"
PREFERRED_VERSION_gstreamer = "0.10.36"
PREFERRED_VERSION_gnupg = "2.2.4"

# Choose the board you are building for
#MACHINE="raspberrypi"
#MACHINE="raspberrypi0"
#MACHINE="raspberrypi0-wifi"
#MACHINE="raspberrypi2"
MACHINE = "raspberrypi3"
#MACHINE="raspberrypi-cm"
#MACHINE="raspberrypi-cm3"

# Choices are Image or zImage if NOT using u-boot (no u-boot is the default)
# Choices are uImage or zImage if using u-boot, though if you choose zImage
# with u-boot you will also have to change the boot script boot command
KERNEL_IMAGETYPE = "zImage"

ENABLE_UART="1"

DISTRO = "poky"

PACKAGE_CLASSES = "package_deb"

DEB_GPG_PASSPHRASE_FILE = "${TOPDIR}/conf/signing_passphrase"
DEB_GPG_SIGNATURE_TYPE = "ASC"
DEB_GPG_NAME = "330C15C0"
# GPG_BIN  = "/usr/bin/gpg"

# i686 or x86_64
SDKMACHINE = "x86_64"

#EXTRA_IMAGE_FEATURES = "debug-tweaks"
INHERIT += "extrausers"

LINUXCNC_USER     = "linuxcnc"
LINUXCNC_PASSWORD = "linuxcnc"

EXTRA_USERS_PARAMS = "\
        usermod -L root; \
        useradd -G sudo ${LINUXCNC_USER}; \
        usermod -P ${LINUXCNC_PASSWORD} ${LINUXCNC_USER}; \
"

USER_CLASSES = "image-mklibs image-prelink"

PATCHRESOLVE = "noop"

RM_OLD_IMAGE = "1"

# INHERIT += "rm_work"

CONF_VERSION = "1"
```
